#include "display.h"

#define ST7789_RESET_PIN     GPIO_PIN_4
#define ST7789_DC_PIN        GPIO_PIN_5
#define ST7789_BL_PIN        GPIO_PIN_6

#define ST7789_RESET_PORT    GPIOA
#define ST7789_DC_PORT       GPIOA
#define ST7789_BL_PORT       GPIOA

extern SPI_HandleTypeDef hspi1;

static const uint8_t font8x8_basic[128][8] = {
    {0x00, 0x00, 0x00, 0x00, 0x00, 0x00, 0x00, 0x00}, // 0x00
    {0x3C, 0x42, 0xA9, 0x85, 0xA9, 0x91, 0x42, 0x3C}, // smiley
    {0x3C, 0x42, 0xA5, 0xA9, 0x91, 0xA5, 0x42, 0x3C}, // inverted smiley
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    {0x00, 0x00, 0x00, 0x00, 0x00, 0x00, 0x00, 0x00}, // 0x7F
};

void ST7789_WriteCommand(uint8_t cmd) {
    HAL_GPIO_WritePin(ST7789_DC_PORT, ST7789_DC_PIN, GPIO_PIN_RESET);
    HAL_SPI_Transmit(&hspi1, &cmd, 1, HAL_MAX_DELAY);
}

void ST7789_WriteData(uint8_t data) {
    HAL_GPIO_WritePin(ST7789_DC_PORT, ST7789_DC_PIN, GPIO_PIN_SET);
    HAL_SPI_Transmit(&hspi1, &data, 1, HAL_MAX_DELAY);
}

void ST7789_SetAddressWindow(uint16_t x0, uint16_t y0, uint16_t x1, uint16_t y1) {
    ST7789_WriteCommand(0x2A);
    ST7789_WriteData(x0 >> 8);
    ST7789_WriteData(x0 & 0xFF);
    ST7789_WriteData(x1 >> 8);
    ST7789_WriteData(x1 & 0xFF);

    ST7789_WriteCommand(0x2B);
    ST7789_WriteData(y0 >> 8);
    ST7789_WriteData(y0 & 0xFF);
    ST7789_WriteData(y1 >> 8);
    ST7789_WriteData(y1 & 0xFF);

    ST7789_WriteCommand(0x2C);
}

void ST7789_DrawPixel(uint16_t x, uint16_t y, uint16_t color) {
    ST7789_SetAddressWindow(x, y, x + 1, y + 1);
    ST7789_WriteData(color >> 8);
    ST7789_WriteData(color & 0xFF);
}

void ST7789_DrawChar(uint16_t x, uint16_t y, char c, uint16_t color, uint16_t bgcolor) {
    int i, j;
    const uint8_t *char_data = font8x8_basic[(uint8_t)c];


    for (i = 0; i < 8; i++) {
        for (j = 0; j < 8; j++) {
            if (char_data[i] & (0x80 >> j)) {
                ST7789_DrawPixel(x + j, y + i, color);
            } else {
                ST7789_DrawPixel(x + j, y + i, bgcolor);
            }
        }
    }
}

void ST7789_DrawString(uint16_t x, uint16_t y, const char *str, uint16_t color, uint16_t bgcolor) {
    int i = 0;
    while (str[i] != '\0') {
        ST7789_DrawChar(x + i * 8, y, str[i], color, bgcolor);
        i++;
    }
}

void ST7789_Init(void) {

    HAL_GPIO_WritePin(ST7789_RESET_PORT, ST7789_RESET_PIN, GPIO_PIN_RESET);
    HAL_Delay(50);
    HAL_GPIO_WritePin(ST7789_RESET_PORT, ST7789_RESET_PIN, GPIO_PIN_SET);
    HAL_Delay(150);

    ST7789_WriteCommand(0x01);
    HAL_Delay(150);

    ST7789_WriteCommand(0x11);
    HAL_Delay(120);

    ST7789_WriteCommand(0x36);
    ST7789_WriteData(0x00);

    ST7789_WriteCommand(0x3A);
    ST7789_WriteData(0x55);

    ST7789_WriteCommand(0x29);
    HAL_Delay(50);

    HAL_GPIO_WritePin(ST7789_BL_PORT, ST7789_BL_PIN, GPIO_PIN_SET);
}

void Display_Print(const char *str) {
    ST7789_DrawString(10, 10, str, 0xFFFF, 0x0000);
}


void Display_ShowMenu(void) {
    ST7789_DrawString(10, 10, "=== Menu Principal ===", 0xFFFF, 0x0000);
    ST7789_DrawString(10, 30, "1. Servir racao", 0xFFFF, 0x0000);
    ST7789_DrawString(10, 50, "2. Configurar horario", 0xFFFF, 0x0000);
    ST7789_DrawString(10, 70, "3. Sair", 0xFFFF, 0x0000);
    ST7789_DrawString(10, 90, "======================", 0xFFFF, 0x0000);
}


void Display_ShowMessage(const char *msg, uint8_t linha) {
    ST7789_DrawString(10, linha * 10, msg, 0xFFFF, 0x0000);
}


void Display_ShowProgressBar(int32_t valorAtual, int32_t valorMaximo) {
    int32_t progresso = (valorAtual * 100) / valorMaximo;
    if (progresso > 100) progresso = 100;

    int width = 100;
    int filled = (progresso * width) / 100;

    for (int i = 0; i < width; i++) {
        if (i < filled) {
            ST7789_DrawPixel(10 + i, 120, 0x07E0);
        } else {
            ST7789_DrawPixel(10 + i, 120, 0x0000);
        }
    }
}
